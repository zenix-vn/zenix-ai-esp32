## ESP32P4-M3/main/Kconfig.projbuild
```kconfig
menu "Zenix AI Client"

    menu "Wi-Fi (mac dinh; thuong cau hinh qua Wi-Fi Zin-Setup)"
        config XZ_WIFI_SSID
            string "Wi-Fi SSID"
            default ""
        config XZ_WIFI_PASSWORD
            string "Wi-Fi password"
            default ""
    endmenu

    menu "AI server"
        config XZ_OTA_URL
            string "OTA / activation URL"
            default "https://dev.zenix.vn/xiaozhi/ota/"
            help
                Thiet bi POST thong tin len URL nay de nhan websocket url, token
                va ma kich hoat. Server xiaozhi tu host (xiaozhi-esp32-server)
                thuong la http://<ip>:8003/xiaozhi/ota/

        config XZ_WS_URL
            string "WebSocket URL (de trong = lay tu OTA)"
            default ""
            help
                Neu dien, bo qua buoc OTA va ket noi thang toi URL nay,
                vi du ws://192.168.1.10:8000/xiaozhi/v1/

        config XZ_WS_TOKEN
            string "WebSocket token (chi dung khi dien WS URL)"
            default "test-token"

        config XZ_BOARD_NAME
            string "Board name (User-Agent)"
            default "zenix-esp32p4-m3"
    endmenu

    menu "Board pins"
        config XZ_I2C_SDA
            int "I2C SDA GPIO"
            default 7
        config XZ_I2C_SCL
            int "I2C SCL GPIO"
            default 8
        config XZ_ES8311_ADDR
            hex "ES8311 I2C address (7-bit)"
            default 0x18
        config XZ_I2S_MCLK
            int "I2S MCLK GPIO"
            default 13
        config XZ_I2S_BCLK
            int "I2S BCLK GPIO"
            default 12
        config XZ_I2S_WS
            int "I2S WS (LRCK) GPIO"
            default 10
        config XZ_I2S_DOUT
            int "I2S DOUT (to codec DSDIN) GPIO"
            default 9
        config XZ_I2S_DIN
            int "I2S DIN (from codec ASDOUT) GPIO"
            default 11
        config XZ_PA_GPIO
            int "Speaker amplifier enable GPIO (-1 = none)"
            default 53
        config XZ_BUTTON_GPIO
            int "Push-to-talk button GPIO (active low)"
            default 35
    endmenu

    menu "Audio"
        config XZ_VOLUME
            int "Default speaker volume (0-100)"
            range 0 100
            default 70
        config XZ_MIC_GAIN
            int "Microphone gain (dB)"
            range 0 42
            default 30
    endmenu

endmenu
```

## ESP32P4-M3/sdkconfig.defaults
```kconfig
CONFIG_IDF_TARGET="esp32p4"

# Flash 16MB (Boya), QIO
CONFIG_ESPTOOLPY_FLASHSIZE_16MB=y
CONFIG_ESPTOOLPY_FLASHMODE_QIO=y
CONFIG_PARTITION_TABLE_CUSTOM=y
CONFIG_PARTITION_TABLE_CUSTOM_FILENAME="partitions.csv"
CONFIG_SPI_FLASH_SUPPORT_BOYA_CHIP=y

# PSRAM 32MB @200MHz
CONFIG_SPIRAM=y
CONFIG_SPIRAM_SPEED_200M=y
CONFIG_SPIRAM_TRY_ALLOCATE_WIFI_LWIP=y
CONFIG_SPIRAM_MALLOC_ALWAYSINTERNAL=1024
CONFIG_SPIRAM_MALLOC_RESERVE_INTERNAL=65536
CONFIG_MBEDTLS_EXTERNAL_MEM_ALLOC=y

# Wi-Fi qua chip phu ESP32-C6 (ESP-Hosted SDIO)
CONFIG_SLAVE_IDF_TARGET_ESP32C6=y

CONFIG_ESP_MAIN_TASK_STACK_SIZE=8192
CONFIG_FREERTOS_HZ=1000
CONFIG_COMPILER_OPTIMIZATION_PERF=y

# Bootloader gon de vua 0x2000-0x8000
CONFIG_BOOTLOADER_LOG_LEVEL_WARN=y
CONFIG_BOOTLOADER_COMPILER_OPTIMIZATION_SIZE=y

# Web quan ly + WebSocket + mDNS can them socket
CONFIG_LWIP_MAX_SOCKETS=16
CONFIG_HTTPD_MAX_REQ_HDR_LEN=2048
CONFIG_HTTPD_MAX_URI_LEN=1024
```
